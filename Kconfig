## Kconfig
```kconfig
#
# For a description of the syntax of this configuration file,
# see https://www.kernel.org/doc/Documentation/kbuild/kconfig-language.txt
#
mainmenu "OpenSwitch Configuration for \"$CONFIGURED_PLATFORM\" Platform"

# Currently configured platform
config CONFIGURED_PLATFORM
        string
        option env="CONFIGURED_PLATFORM"

# Location of ops-build
config BUILD_ROOT
	string
	option env="BUILD_ROOT"

# Current distro
config DISTRO
	string
	option env="DISTRO"

# Include platform specific Kconfig file
source "$BUILD_ROOT/yocto/$DISTRO/meta-platform-$DISTRO-$CONFIGURED_PLATFORM/Kconfig"
```

## Kconfig.bcm
```kconfig
#
# Vendor specific features
#
menu "Forwarding ASIC (Broadcom) Features"

config BROADVIEW
	bool "Broadview"
	depends on BUFMOND
	default y
	---help---
	  BroadView Instrumentation exposes various instrumentation
	  capabilities in Broadcom silicon.

endmenu
```

## tools/config/Kconfig
```kconfig
#
# For a description of the syntax of this configuration file,
# see https://www.kernel.org/doc/Documentation/kbuild/kconfig-language.txt
#
mainmenu "OpenSwitch Configuration for \"$CONFIGURED_PLATFORM\" Platform"

# Currently configured platform
config CONFIGURED_PLATFORM
        string
        option env="CONFIGURED_PLATFORM"

# Location of ops-build
config BUILD_ROOT
	string
	option env="BUILD_ROOT"

# Current distro
config DISTRO
	string
	option env="DISTRO"

#
# Source all top level Kconfig files
# !!! DO NOT CHANGE THE ORDER !!!
#
# Include platform specific Kconfig file
source "$BUILD_ROOT/yocto/$DISTRO/meta-platform-$DISTRO-$CONFIGURED_PLATFORM/Kconfig"

# General setup
source "$BUILD_ROOT/yocto/$DISTRO/meta-distro-$DISTRO/recipes-ops/utils/Kconfig"

# Platform vendor specific options
config HAVE_SIM_CONFIG_FILE
	def_bool n

config HAVE_ACCTON_CONFIG_FILE
	def_bool n

if HAVE_SIM_CONFIG_FILE
	# Simulation environment (appliance genericx86-64)
	source "$BUILD_ROOT/tools/config/Kconfig.sim"
endif

if HAVE_ACCTON_CONFIG_FILE
	# Accton (as5712 as6712 as7712)
	source "$BUILD_ROOT/tools/config/Kconfig.act"
endif

# Forwarding ASIC vendor specific features
# None for simulation environment (appliance genericx86-64)
config HAVE_BROADCOM_CONFIG_FILE
	def_bool n

if HAVE_BROADCOM_CONFIG_FILE
	# as5712 as6712 as7712
	source "$BUILD_ROOT/tools/config/Kconfig.bcm"
endif

# L2 feature set
source "$BUILD_ROOT/yocto/$DISTRO/meta-distro-$DISTRO/recipes-ops/l2/Kconfig"

# L3 and above feature set
source "$BUILD_ROOT/yocto/$DISTRO/meta-distro-$DISTRO/recipes-ops/l3/Kconfig"

# Management interface options
source "$BUILD_ROOT/yocto/$DISTRO/meta-distro-$DISTRO/recipes-ops/mgmt/Kconfig"
```

## tools/config/Kconfig.bcm
```kconfig
#
# Vendor specific features
#
menu "Forwarding ASIC (Broadcom) Features"

config OPS_BROADVIEW
	bool "Broadview"
	depends on OPS_BUFMOND
	default y
	---help---
	  BroadView Instrumentation exposes various instrumentation
	  capabilities in Broadcom silicon.

endmenu
```

## yocto/openswitch/meta-distro-openswitch/recipes-ops/l2/Kconfig
```kconfig
#
# L2 features
#
menu "Layer 2 Features"

config HAVE_MAX_NUM_PORTS
	def_bool n

config MAX_NUM_PORTS
	int "Max number of physical ports"
	depends on HAVE_MAX_NUM_PORTS
	default 3
	range 1 256
        ---help---
	  This limits the maximum number of physical ports switch can have.

endmenu
```

## yocto/openswitch/meta-distro-openswitch/recipes-ops/l3/Kconfig
```kconfig
#
# L3 and above features
#
menu "Layer 3 and above Features"

config KEY_VALUE_EXAMPLE_L3_PROPERTY
	int "Example: L3 Parameter"
	default 64
	range 8 256
        ---help---
	  This is to demonstrate how to make use of key-value pairs through
	  through OpenSwitch Modular Configuration framework.

endmenu
```

## yocto/openswitch/meta-distro-openswitch/recipes-ops/mgmt/Kconfig
```kconfig
#
# Switch Management features
#
menu "Management Interface Options"

config OPS_NTPD
        bool "Network Time Protocol (NTP) Client"
        default y
        ---help---
          The NTP client feature provides the Network Time Protocol client
          functionality which synchronizes information from NTP servers.
          For more details, please visit:
            http://openswitch.net/documents/dev/ops-ntpd/design

endmenu
```

## yocto/openswitch/meta-distro-openswitch/recipes-ops/utils/Kconfig
```kconfig
#
# Tools and utilities
#
menu "General Setup"

config HAVE_OPS_BUFMOND
	def_bool n

config OPS_BUFMOND
	bool "Buffer Monitor"
	depends on HAVE_OPS_BUFMOND
	default y
	---help---
	  Buffers Monitoring is a feature that provides OpenSwitch users the ability
	  to monitor buffer space consumption inside the ASIC. It's useful for
	  troubleshooting complex performance problems in the data center networking
	  environment.
	  For more details, please visit:
	    http://openswitch.net/documents/dev/ops-bufmond/design

endmenu
```

## yocto/openswitch/meta-platform-openswitch-appliance/Kconfig
```kconfig
config APPLIANCE
	bool
	default y

	# Please add new selects below by sorting them alphabetically
	select HAVE_MAX_NUM_PORTS
	select HAVE_SIM_CONFIG_FILE
	# Please add new selects above by sorting them alphabetically

	---help---
	  Add a description of appliance Platform here.
```

## yocto/openswitch/meta-platform-openswitch-appliance/conf/machine/appliance.conf
```bitbake
DEFAULTTUNE ?= "core2-64"
require conf/machine/include/tune-core2.inc
include conf/machine/include/x86-base.inc

# Include user enabled features
INHERIT += "openswitch-config"
SRC_URI = "${@get_ops_config_file(d)}"
EXTRA_IMAGE_FEATURES += "${@get_ops_config_symbols(d)}"

PREFERRED_PROVIDER_virtual/kernel ?= "linux-yocto"
PREFERRED_VERSION_linux-yocto ?= "3.14%"

MACHINE_EXTRA_RRECOMMENDS += "linux-firmware v86d eee-acpi-scripts"

GLIBC_ADDONS = "nptl"

IMAGE_FSTYPES = "cpio.gz tar.gz"

MACHINE_FEATURES = "pcbios usbhost acpi pci ext2 ext3 x86 vfat serial ops-container"
MACHINE_ESSENTIAL_EXTRA_RDEPENDS += " \
  packagegroup-ops-min \
  packagegroup-ops-min-debug \
  packagegroup-ops-config \
  packagegroup-ops-core \
"

PREFERRED_PROVIDER_virtual/ops-switchd-switch-api-plugin ?= "ops-switchd-container-plugin"

# Allow login root with no password and enable vagrant tweaks
EXTRA_IMAGE_FEATURES += "vagrant-tweaks debug-tweaks"
```

## yocto/openswitch/meta-platform-openswitch-as5712/conf/machine/as5712.conf
```bitbake
DEFAULTTUNE ?= "core2-64"
require conf/machine/include/tune-core2.inc
include conf/machine/include/x86-base.inc

# Include user enabled features
INHERIT += "openswitch-config"
SRC_URI = "${@get_ops_config_file(d)}"
EXTRA_IMAGE_FEATURES += "${@get_ops_config_symbols(d)}"

PREFERRED_PROVIDER_virtual/kernel ?= "linux-ops"
PREFERRED_VERSION_linux-ops ?= "3.9%"

GLIBC_ADDONS = "nptl"

IMAGE_FSTYPES = "cpio.gz tar.gz"

MACHINE_FEATURES = "pcbios usbhost acpi serial pci ext2 ext3 x86 vfat broadcom"
MACHINE_ESSENTIAL_EXTRA_RDEPENDS += " \
  packagegroup-ops-min \
  packagegroup-ops-min-debug \
  packagegroup-ops-config \
"

# Allow login root with no password
EXTRA_IMAGE_FEATURES +="debug-tweaks"

PREFERRED_PROVIDER_virtual/ops-switchd-switch-api-plugin ?= "ops-switchd-opennsl-plugin"

MACHINE_EXTRA_RRECOMMENDS += "dmidecode"
```
