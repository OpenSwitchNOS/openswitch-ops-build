## yocto/openswitch/meta-platform-openswitch-usermode/conf/machine/usermode.conf
```bitbake
DEFAULTTUNE ?= "core2-64"
require conf/machine/include/tune-core2.inc
include conf/machine/include/x86-base.inc

PREFERRED_PROVIDER_virtual/kernel ?= "linux-ops"
PREFERRED_VERSION_linux-ops ?= "4.5%"

# UML doesn't hae any VT102 consoles and no serial lines
BAD_RECOMMENDATIONS = "systemd-vconsole-setup systemd-serialgetty"

GLIBC_ADDONS = "nptl"

IMAGE_FSTYPES = "cpio.gz tar.gz"

MACHINE_FEATURES = "ext2 ext3 x86 vfat serial ops-container"
MACHINE_ESSENTIAL_EXTRA_RDEPENDS += " \
  packagegroup-ops-min \
  packagegroup-ops-min-debug \
  packagegroup-ops-base \
  packagegroup-ops-core \
"

PREFERRED_PROVIDER_virtual/ops-switchd-switch-api-plugin ?= "ops-switchd-container-plugin"

# Allow login root with no password
# TODO(bluecmd): Since vagrant-tweaks pull open-vm-tools which doesn't compile with UML
# we cannot enable it here.
#EXTRA_IMAGE_FEATURES += "vagrant-tweaks"
```
